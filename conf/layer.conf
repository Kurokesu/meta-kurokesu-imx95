## conf/layer.conf
```bitbake
# We have a conf and classes directory, add to BBPATH
BBPATH .= ":${LAYERDIR}"

# We have recipes-* directories, add to BBFILES
BBFILES += "${LAYERDIR}/recipes-*/*/*.bb \
            ${LAYERDIR}/recipes-*/*/*.bbappend"

BBFILE_COLLECTIONS += "meta-kurokesu-imx95"
BBFILE_PATTERN_meta-kurokesu-imx95 = "^${LAYERDIR}/"
BBFILE_PRIORITY_meta-kurokesu-imx95 = "10"

LAYERDEPENDS_meta-kurokesu-imx95 = "core meta-bsp-imx95 fsl-sdk-release"
LAYERSERIES_COMPAT_meta-kurokesu-imx95 = "walnascar"
```
